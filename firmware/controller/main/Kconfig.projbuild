## firmware/controller/main/Kconfig.projbuild
```kconfig
menu "Radiance3D motion controller"

config RADIANCE3D_HOST_HEARTBEAT_TIMEOUT_MS
    int "Host heartbeat timeout (ms)"
    range 250 60000
    default 2000
    help
        Timeout enforced by the safety task after host activity has been seen.

config RADIANCE3D_TASK_WDT_TIMEOUT_MS
    int "Application task-watchdog timeout (ms)"
    range 1000 30000
    default 5000

config RADIANCE3D_PROTOCOL_TASK_STACK
    int "Protocol task stack size"
    range 2048 16384
    default 4096

config RADIANCE3D_MOTION_TASK_STACK
    int "Motion task stack size"
    range 3072 16384
    default 6144

config RADIANCE3D_SAFETY_TASK_STACK
    int "Safety task stack size"
    range 2048 8192
    default 3072

config RADIANCE3D_DIAGNOSTICS_TASK_STACK
    int "Diagnostics task stack size"
    range 2048 8192
    default 3072

config RADIANCE3D_DIAGNOSTICS_INTERVAL_MS
    int "Diagnostics task interval (ms)"
    range 100 10000
    default 1000

endmenu
```
